## .ci/zephyr/compare/boards/local/rv32_compare/board.yml
```yaml
board:
  name: rv32_compare
  full_name: GCC single-core RV32 S-mode comparison
  vendor: others
  socs:
    - name: qemu_virt_riscv32
```

## configs/wasm_defconfig
```kconfig
# WebAssembly build with Emscripten
CONFIG_BUILD_WASM=y
CONFIG_JIT=y
# CONFIG_T2C is not set
# CONFIG_LTO is not set
CONFIG_OPTIMIZE_LEVEL=3
CONFIG_BLOCK_CHAINING=y
```

## configs/wasm_system_defconfig
```kconfig
# WebAssembly build with Emscripten
CONFIG_BUILD_WASM=y
# CONFIG_LTO is not set
CONFIG_OPTIMIZE_LEVEL=3
CONFIG_BLOCK_CHAINING=y
# System emulation for Linux kernel
CONFIG_SYSTEM=y
CONFIG_GOLDFISH_RTC=y
```
