## CMakeLists.txt
```
# SPDX-License-Identifier: Apache-2.0
cmake_minimum_required(VERSION 3.28.0)
find_package(Zephyr REQUIRED HINTS $ENV{ZEPHYR_BASE})
project(zephyr_fixed_work)
if(NOT BENCH_CASE MATCHES "^(boot|scheduling|allocation|serialization|computation)$")
  message(FATAL_ERROR "Unknown BENCH_CASE")
endif()
target_compile_definitions(app PRIVATE BENCH_CASE="${BENCH_CASE}")
target_sources(app PRIVATE src/main.c src/${BENCH_CASE}.c)
if(BENCH_CASE STREQUAL "serialization")
  list(APPEND CMAKE_MODULE_PATH ${ZEPHYR_BASE}/modules/nanopb)
  include(nanopb)
  zephyr_nanopb_sources(app proto/simple.proto)
endif()

if(BENCH_CASE STREQUAL "computation")
  target_include_directories(app PRIVATE coremark ${COREMARK_DIR})
  foreach(source core_list_join core_matrix core_state core_util core_main)
    target_sources(app PRIVATE ${COREMARK_DIR}/${source}.c)
  endforeach()
  set_source_files_properties(${COREMARK_DIR}/core_main.c PROPERTIES
    COMPILE_DEFINITIONS "main=unused_coremark_main")
endif()
```

## prj.conf
```kconfig
CONFIG_MAIN_STACK_SIZE=4096
CONFIG_HEAP_MEM_POOL_SIZE=8192
CONFIG_ASSERT=y
CONFIG_BOOT_BANNER=y
CONFIG_PRINTK=y
CONFIG_CONSOLE=y
CONFIG_UART_CONSOLE=y
CONFIG_SMP=n
CONFIG_SPEED_OPTIMIZATIONS=y
```

## src/main.c
```c
/* SPDX-License-Identifier: Apache-2.0 */
#include "bench.h"

int main(void)
{
    uint32_t checksum = 0;

    if ((!bench_run(&checksum)) || (checksum != bench_expected)) {
        printk("RV32EMU_BENCH_FAIL case=%s phase=warmup\n", BENCH_CASE);
        return 1;
    }
    printk("RV32EMU_BENCH_WARMUP case=%s iterations=%u checksum=%u\n",
           BENCH_CASE, bench_iterations, checksum);
    printk("RV32EMU_BENCH_READY case=%s\n", BENCH_CASE);
    printk("RV32EMU_BENCH_START case=%s iterations=%u\n", BENCH_CASE,
           bench_iterations);
    checksum = 0;
    bool valid = bench_run(&checksum);

    printk("RV32EMU_BENCH_END case=%s iterations=%u checksum=%u status=%s\n",
           BENCH_CASE, bench_iterations, checksum,
           valid && (checksum == bench_expected) ? "PASS" : "FAIL");
    return valid && (checksum == bench_expected) ? 0 : 1;
}
```

## src/allocation.c
```c
/*
 * Copyright (c) 2026 Måns Ansgariusson <mansgariusson@gmail.com>
 * SPDX-License-Identifier: Apache-2.0
 */
/*
 * Adapted from tests/benchmarks/memory_allocators/src/k_heap.c at
 * Zephyr bbc6385f0a2: fixed alloc/realloc/free with payload checks.
 */
#include <string.h>
#include "bench.h"

K_HEAP_DEFINE(heap, 1024);
const uint32_t bench_iterations = WORK_ITERATIONS;
const uint32_t bench_expected = WORK_ITERATIONS * 384U;
bool bench_run(uint32_t *checksum)
{
    for (uint32_t i = 0; i < WORK_ITERATIONS; ++i) {
        uint8_t *p = k_heap_alloc(&heap, 128, K_NO_WAIT);

        if (!p) {
            return false;
        }
        memset(p, (uint8_t) i, 128);
        uint8_t *q = k_heap_realloc(&heap, p, 256, K_NO_WAIT);

        if (!q) {
            k_heap_free(&heap, p);
            return false;
        }
        for (unsigned j = 0; j < 128; ++j) {
            if (q[j] != (uint8_t) i) {
                k_heap_free(&heap, q);
                return false;
            }
        }
        *checksum += 384;
        k_heap_free(&heap, q);
    }
    return true;
}
```

## src/bench.h
```c
/* SPDX-License-Identifier: Apache-2.0 */
#include <stdbool.h>
#include <stdint.h>
#include <zephyr/kernel.h>
#include <zephyr/sys/printk.h>

#define WORK_ITERATIONS 1000U
bool bench_run(uint32_t *checksum);
extern const uint32_t bench_iterations;
extern const uint32_t bench_expected;
```

## src/boot.c
```c
/*
 * Copyright (c) 2012-2014 Wind River Systems, Inc.
 * SPDX-License-Identifier: Apache-2.0
 */
/* Zephyr samples/hello_world/src/main.c at bbc6385f0a2 (Apache-2.0). */
#include "bench.h"

const uint32_t bench_iterations = 1;
const uint32_t bench_expected = 1;
bool bench_run(uint32_t *checksum)
{
    printk("Hello World! %s\n", CONFIG_BOARD_TARGET);
    *checksum = 1;
    return true;
}
```

## src/computation.c
```c
/*
 * Copyright 2018 Embedded Microprocessor Benchmark Consortium (EEMBC)
 * SPDX-License-Identifier: Apache-2.0
 */
/*
 * Initialization follows core_main.c at 1f483d5b8316; all three original
 * algorithms run through iterate(), with the upstream 2K CRC checks.
 * Host fixed-work timing does not produce a reportable CoreMark score.
 */
#include <string.h>
#include "bench.h"
#include "coremark.h"
static uint8_t memory[TOTAL_DATA_SIZE] __aligned(8);
volatile ee_s32 seed1_volatile;
volatile ee_s32 seed2_volatile;
volatile ee_s32 seed3_volatile = 0x66;
volatile ee_s32 seed4_volatile = ITERATIONS;
volatile ee_s32 seed5_volatile;
ee_u32 default_num_contexts = 1;
const uint32_t bench_iterations = ITERATIONS;
const uint32_t bench_expected = 0xe714U + 0x1fd7U + 0x8e3aU + 0x988cU;
bool bench_run(uint32_t *checksum)
{
    core_results result = {0};

    memset(memory, 0, sizeof(memory));
    result.seed1 = seed1_volatile;
    result.seed2 = seed2_volatile;
    result.seed3 = seed3_volatile;
    result.iterations = ITERATIONS;
    result.execs = ALL_ALGORITHMS_MASK;
    result.size = TOTAL_DATA_SIZE / 3;
    result.memblock[0] = memory;
    for (unsigned i = 0; i < 3; ++i) {
        result.memblock[i + 1] = memory + result.size * i;
    }
    result.list = core_list_init(result.size, result.memblock[1], result.seed1);
    core_init_matrix(result.size, result.memblock[2],
                     (ee_s32) result.seed1 | ((ee_s32) result.seed2 << 16),
                     &result.mat);
    core_init_state(result.size, result.seed1, result.memblock[3]);
    iterate(&result);
    *checksum =
        result.crclist + result.crcmatrix + result.crcstate + result.crc;
    return (result.crclist == 0xe714) && (result.crcmatrix == 0x1fd7) &&
           (result.crcstate == 0x8e3a) && (result.crc == 0x988c) &&
           (check_data_types() == 0);
}
```

## src/scheduling.c
```c
/*
 * Copyright (c) 2012-2015 Wind River Systems, Inc.
 * Copyright (c) 2020,2023 Intel Corporation.
 * SPDX-License-Identifier: Apache-2.0
 */
/*
 * Adapted from Zephyr bbc6385f0a2 tests/benchmarks/latency_measure/src/
 * thread_switch_yield.c, sema_test_signal_release.c, mutex_lock_unlock.c.
 * Fixed work replaces cycle sampling; recursive mutex depth is retained.
 */
#include "bench.h"
K_SEM_DEFINE(request, 0, 1);
K_SEM_DEFINE(reply, 0, 1);
K_MUTEX_DEFINE(mutex);
K_THREAD_STACK_DEFINE(stack, 1024);
static struct k_thread worker;
K_THREAD_STACK_DEFINE(yield_stack_a, 1024);
K_THREAD_STACK_DEFINE(yield_stack_b, 1024);
static struct k_thread yield_a, yield_b;
static uint32_t yield_count;
static bool yield_valid;
static uint32_t received;
const uint32_t bench_iterations = WORK_ITERATIONS;
const uint32_t bench_expected = WORK_ITERATIONS * 5U;
static void entry(void *a, void *b, void *c)
{
    ARG_UNUSED(a);
    ARG_UNUSED(b);
    ARG_UNUSED(c);
    for (unsigned i = 0; i < WORK_ITERATIONS; ++i) {
        k_sem_take(&request, K_FOREVER);
        ++received;
        k_sem_give(&reply);
    }
}
static void yield_entry(void *a, void *b, void *c)
{
    unsigned parity = (uintptr_t) a;

    ARG_UNUSED(b);
    ARG_UNUSED(c);
    for (unsigned i = 0; i < WORK_ITERATIONS; ++i) {
        if (yield_count != i * 2 + parity) {
            yield_valid = false;
        }
        ++yield_count;
        k_yield();
    }
}
bool bench_run(uint32_t *checksum)
{
    yield_count = 0;
    yield_valid = true;
    k_thread_create(&yield_a, yield_stack_a,
                    K_THREAD_STACK_SIZEOF(yield_stack_a), yield_entry,
                    (void *) 0, NULL, NULL, K_PRIO_COOP(1), 0, K_FOREVER);
    k_thread_create(&yield_b, yield_stack_b,
                    K_THREAD_STACK_SIZEOF(yield_stack_b), yield_entry,
                    (void *) 1, NULL, NULL, K_PRIO_COOP(1), 0, K_FOREVER);
    /* Both equal-priority peers must be runnable before the first yield. */
    k_sched_lock();
    k_thread_start(&yield_a);
    k_thread_start(&yield_b);
    k_sched_unlock();
    if ((k_thread_join(&yield_a, K_FOREVER) != 0) ||
        (k_thread_join(&yield_b, K_FOREVER) != 0) || (!yield_valid) ||
        (yield_count != WORK_ITERATIONS * 2)) {
        return false;
    }
    *checksum += yield_count;
    received = 0;
    k_thread_create(&worker, stack, K_THREAD_STACK_SIZEOF(stack), entry, NULL,
                    NULL, NULL, K_PRIO_PREEMPT(1), 0, K_NO_WAIT);
    for (unsigned i = 0; i < WORK_ITERATIONS; ++i) {
        k_sem_give(&request);
        if ((k_sem_take(&reply, K_FOREVER) != 0) || (received != i + 1)) {
            return false;
        }
        ++*checksum;
    }
    if (k_thread_join(&worker, K_FOREVER) != 0) {
        return false;
    }
    for (unsigned i = 0; i < WORK_ITERATIONS; ++i) {
        if (k_mutex_lock(&mutex, K_NO_WAIT) != 0) {
            return false;
        }
        ++*checksum;
    }
    for (unsigned i = 0; i < WORK_ITERATIONS; ++i) {
        if (k_mutex_unlock(&mutex) != 0) {
            return false;
        }
        ++*checksum;
    }
    return (received == WORK_ITERATIONS) && (k_sem_count_get(&request) == 0) &&
           (k_sem_count_get(&reply) == 0);
}
```

## src/serialization.c
```c
/*
 * Copyright (c) 2023 Basalte bv
 * SPDX-License-Identifier: Apache-2.0
 */
/*
 * Adapted from Zephyr bbc6385f0a2 tests/modules/nanopb/src/main.c.
 * Retain the simple-message roundtrip and check every decoded byte.
 */
#include <pb_decode.h>
#include <pb_encode.h>
#include <proto/simple.pb.h>
#include <string.h>
#include "bench.h"
const uint32_t bench_iterations = WORK_ITERATIONS;
const uint32_t bench_expected = WORK_ITERATIONS * 28U;
bool bench_run(uint32_t *checksum)
{
    for (unsigned n = 0; n < WORK_ITERATIONS; ++n) {
        uint8_t buffer[SimpleMessage_size];
        SimpleMessage msg = SimpleMessage_init_zero;

        for (size_t i = 0; i < sizeof(msg.buffer); ++i) {
            msg.buffer[i] = i;
        }
        pb_ostream_t out = pb_ostream_from_buffer(buffer, sizeof(buffer));

        if ((!pb_encode(&out, SimpleMessage_fields, &msg)) ||
            (out.bytes_written != 10) || (buffer[0] != 0x0a) ||
            (buffer[1] != 8) || (memcmp(buffer + 2, msg.buffer, 8) != 0)) {
            return false;
        }
        memset(&msg, 0, sizeof(msg));
        pb_istream_t in = pb_istream_from_buffer(buffer, out.bytes_written);

        if ((!pb_decode(&in, SimpleMessage_fields, &msg)) ||
            (in.bytes_left != 0)) {
            return false;
        }
        for (size_t i = 0; i < sizeof(msg.buffer); ++i) {
            if (msg.buffer[i] != i) {
                return false;
            }
            *checksum += msg.buffer[i];
        }
        pb_release(SimpleMessage_fields, &msg);
    }
    return true;
}
```
