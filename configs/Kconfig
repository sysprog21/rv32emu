## configs/Kconfig
```kconfig
# rv32emu Configuration
#
# RISC-V RV32 Emulator with tiered JIT compilation

mainmenu "rv32emu Configuration"

# Environment Detection (read-only, set by tools/detect-env.py)

menu "Toolchain Detection"

config COMPILER_TYPE
    string
    default "$(shell,tools/detect-env.py --compiler 2>/dev/null || echo Unknown)"

config HAVE_EMCC
    bool
    default $(shell,tools/detect-env.py --have-emcc 2>/dev/null)

config CC_IS_CLANG
    def_bool $(shell,tools/detect-env.py --is-clang 2>/dev/null)

config CC_IS_GCC
    def_bool $(shell,tools/detect-env.py --is-gcc 2>/dev/null)

comment "Emscripten detected - WebAssembly build available"
    depends on HAVE_EMCC

comment "Emscripten not found - install emsdk for WebAssembly builds"
    depends on !HAVE_EMCC

endmenu

# Build Target Selection

menu "Build Target"

choice
    prompt "Build Target"
    default BUILD_NATIVE
    help
      Select the build target platform.

config BUILD_NATIVE
    bool "Native (Linux/macOS/Windows)"
    help
      Build native executable for the host platform.
      Uses system compiler (GCC or Clang).

config BUILD_WASM
    bool "WebAssembly (Emscripten)"
    depends on HAVE_EMCC
    help
      Build WebAssembly module for web browsers.
      Requires Emscripten SDK (emsdk) to be installed and activated.

      The build will use 'emcc' as the compiler.
      Run in browser with: make start-web

endchoice

# Internal: Set CC_IS_EMCC when BUILD_WASM is selected
config CC_IS_EMCC
    bool
    default BUILD_WASM

comment "Build mode: WebAssembly (Emscripten)"
    depends on BUILD_WASM

comment "Build mode: Native"
    depends on BUILD_NATIVE

endmenu

# Dependency Detection

config HAVE_SDL2
    bool
    default n if CC_IS_EMCC
    default $(shell,tools/detect-env.py --have-sdl2 2>/dev/null)

config HAVE_SDL2_MIXER
    bool
    default n if CC_IS_EMCC
    default $(shell,tools/detect-env.py --have-sdl2-mixer 2>/dev/null)

config HAVE_LLVM18
    bool
    default $(shell,tools/detect-env.py --have-llvm18 2>/dev/null)

config HAVE_RISCV_TOOLCHAIN
    bool
    default $(shell,tools/detect-env.py --have-riscv-toolchain 2>/dev/null)

# RISC-V ISA Extensions

menu "RISC-V ISA Configuration"

choice
    prompt "Base Integer Instruction Set"
    default RV32I

config RV32I
    bool "RV32I (Standard 32 registers)"
    help
      Standard RISC-V 32-bit base integer instruction set
      with 32 general-purpose registers.

config RV32E
    bool "RV32E (Embedded 16 registers)"
    help
      Reduced RISC-V base integer instruction set for embedded
      systems with only 16 general-purpose registers.

endchoice

comment "Standard Extensions"

config EXT_M
    bool "M - Integer Multiplication and Division"
    default y
    help
      Enable integer multiplication and division instructions.
      Required for most practical programs.

config EXT_A
    bool "A - Atomic Instructions"
    default y
    help
      Enable atomic memory operation instructions.
      Required for multi-threading and synchronization.

config EXT_F
    bool "F - Single-Precision Floating-Point"
    default y
    help
      Enable single-precision (32-bit) floating-point instructions.
      Uses Berkeley SoftFloat for IEEE 754 compliance.

config EXT_C
    bool "C - Compressed Instructions"
    default y
    help
      Enable 16-bit compressed instruction encoding.
      Reduces code size by approximately 25-30%.

comment "Zicsr and Zifencei Extensions"

config Zicsr
    bool "Zicsr - Control and Status Register"
    default y
    help
      Enable CSR (Control and Status Register) instructions.
      Required for privileged mode and system emulation.

config Zifencei
    bool "Zifencei - Instruction-Fetch Fence"
    default y
    help
      Enable instruction-fetch fence for self-modifying code.
      Required for JIT compilation support.

comment "Bit Manipulation Extensions (Zb*)"

config Zba
    bool "Zba - Address Generation"
    default y
    help
      Enable address generation bit manipulation instructions.
      Provides efficient shifted-add operations.

config Zbb
    bool "Zbb - Basic Bit Manipulation"
    default y
    help
      Enable basic bit manipulation instructions.
      Includes count, rotate, byte-reverse operations.

config Zbc
    bool "Zbc - Carry-less Multiplication"
    default y
    help
      Enable carry-less multiplication instructions.
      Useful for cryptographic applications (GCM, CRC).

config Zbs
    bool "Zbs - Single-bit Instructions"
    default y
    help
      Enable single-bit manipulation instructions.
      Provides efficient bit test, set, clear operations.

endmenu

# Execution Modes

menu "Execution Modes"

comment "Emulation Mode"

choice
    prompt "Execution Engine"
    default INTERPRETER_ONLY
    help
      Select the execution engine for RISC-V instruction emulation.

config INTERPRETER_ONLY
    bool "Interpreter Only"
    help
      Pure interpreter mode using threaded code dispatch.
      Most portable, works on all platforms.

      Uses computed goto for efficient instruction dispatch.

config JIT
    bool "JIT Compilation (Hybrid)"
    depends on !CC_IS_EMCC
    help
      Hybrid interpreter + Just-In-Time compilation.
      Tier-1 JIT uses template-based code generation for hot paths.

      JIT is only available on x86_64 and ARM64 platforms.
      Falls back to interpreter for cold code.

endchoice

config T2C
    bool "Tier-2 LLVM Compiler"
    default y
    depends on JIT && HAVE_LLVM18
    help
      Enable tier-2 JIT compiler powered by LLVM 18.
      Provides advanced optimizations for hot code paths.

      Requires LLVM 18 development libraries.

comment "System Emulation"

config SYSTEM
    bool "System Emulation Mode"
    default n
    help
      Enable system emulation mode for running the Linux kernel.
      Includes MMU, timer, UART, and virtio device emulation.

      When enabled, rv32emu can boot a complete Linux system.
      Requires additional kernel image and rootfs.

config GOLDFISH_RTC
    bool "Enable Goldfish RTC"
    default y
    depends on SYSTEM && !ELF_LOADER
    help
      Enable Goldfish RTC peripheral when running the Linux system.
      Only available in kernel boot mode (without ELF_LOADER).

config ELF_LOADER
    bool "ELF Loader for System Mode"
    default n
    depends on SYSTEM
    help
      Use ELF loader in system mode instead of raw kernel image.

      This option changes the emulator's operating mode:
      - Without ELF_LOADER: Kernel boot mode (-k/-i flags for kernel/initrd)
      - With ELF_LOADER: User-mode ELF execution (runs ELF files directly)

      Enable this for running 'make check' tests in system mode.
      Disable this for booting Linux kernel images.

endmenu

# Performance Optimizations

menu "Performance Options"

config MOP_FUSION
    bool "Macro-op Fusion"
    default y
    help
      Enable macro-operation fusion for common instruction sequences.
      Fuses consecutive instructions into optimized handlers.

      Improves performance by reducing dispatch overhead.

config BLOCK_CHAINING
    bool "Block Chaining"
    default y
    help
      Enable basic block chaining for translated code.
      Links consecutive blocks to avoid dispatch overhead.

      Improves JIT performance significantly.

config LTO
    bool "Link-Time Optimization"
    default y
    depends on CC_IS_GCC || CC_IS_CLANG
    help
      Enable link-time optimization for smaller, faster binaries.
      Increases build time but improves runtime performance.

endmenu

# Debugging and Development

menu "Debugging"

config GDBSTUB
    bool "GDB Remote Debugging"
    default n
    depends on !CC_IS_EMCC
    help
      Enable GDB remote debugging stub.
      Allows debugging RISC-V programs with gdb.

      Connect with: riscv32-unknown-elf-gdb -ex "target remote :1234"

config LOG_COLOR
    bool "Colored Log Output"
    default y
    help
      Enable ANSI color codes in log output.
      Improves readability of debug messages.

config UBSAN
    bool "Undefined Behavior Sanitizer"
    default n
    depends on CC_IS_GCC || CC_IS_CLANG
    help
      Enable UndefinedBehaviorSanitizer for detecting UB at runtime.
      Useful for development and debugging, not for production.

endmenu

# SDL Graphics and Audio

menu "Graphics and Audio"

config SDL
    bool "SDL2 Graphics Support"
    default y
    depends on HAVE_SDL2 || CC_IS_EMCC
    help
      Enable SDL2-based graphics and input support.
      Required for graphical applications like Doom and Quake.

      For WebAssembly builds, uses Emscripten SDL2 port.

config SDL_MIXER
    bool "SDL2_mixer Audio Support"
    default y
    depends on SDL && (HAVE_SDL2_MIXER || CC_IS_EMCC)
    help
      Enable SDL2_mixer for audio playback.
      Supports WAV and MIDI formats.

endmenu

# Testing

menu "Testing"

config ARCH_TEST
    bool "RISC-V Architecture Tests"
    default n
    help
      Build for RISC-V architecture compliance testing.
      Used by 'make arch-test' target.

endmenu

# Build Options

menu "Build Options"

config OPTIMIZE_LEVEL
    int "Optimization Level (0-3)"
    default 2
    range 0 3
    help
      Compiler optimization level:
        0 - No optimization (fastest compile)
        1 - Basic optimization
        2 - Standard optimization (default)
        3 - Aggressive optimization

config OPTIMIZE_SIZE
    bool "Optimize for Size (-Os)"
    default n
    help
      Trade speed for smaller binary size.
      Recommended for embedded or WebAssembly deployments.

config DEBUG_SYMBOLS
    bool "Include Debug Symbols (-g)"
    default n
    help
      Generate debug information for gdb/lldb.
      Increases binary size significantly.

endmenu

# Configuration marker
config CONFIGURED
    bool
    default y
```

## configs/ci_defconfig
```kconfig
# CI configuration with architecture tests
# CONFIG_LTO is not set
# CONFIG_MOP_FUSION is not set
# CONFIG_BLOCK_CHAINING is not set
CONFIG_ARCH_TEST=y
```

## configs/defconfig
```kconfig
# rv32emu default configuration
# Standard desktop build with all extensions enabled

# RISC-V ISA Configuration
CONFIG_RV32I=y
# CONFIG_RV32E is not set
CONFIG_EXT_M=y
CONFIG_EXT_A=y
CONFIG_EXT_F=y
CONFIG_EXT_C=y
CONFIG_Zicsr=y
CONFIG_Zifencei=y
CONFIG_Zba=y
CONFIG_Zbb=y
CONFIG_Zbc=y
CONFIG_Zbs=y

# Execution Modes
CONFIG_INTERPRETER_ONLY=y
# CONFIG_JIT is not set
# CONFIG_T2C is not set
# CONFIG_SYSTEM is not set
# CONFIG_ELF_LOADER is not set

# Performance Options
CONFIG_MOP_FUSION=y
CONFIG_BLOCK_CHAINING=y
CONFIG_LTO=y

# Debugging
# CONFIG_GDBSTUB is not set
CONFIG_LOG_COLOR=y
# CONFIG_UBSAN is not set

# Graphics and Audio
CONFIG_SDL=y
CONFIG_SDL_MIXER=y

# Testing
# CONFIG_ARCH_TEST is not set

# Build Options
CONFIG_OPTIMIZE_LEVEL=2
# CONFIG_OPTIMIZE_SIZE is not set
# CONFIG_DEBUG_SYMBOLS is not set

CONFIG_CONFIGURED=y
```

## configs/mini_defconfig
```kconfig
# Minimal build without SDL for embedded use
# CONFIG_EXT_F is not set
# CONFIG_Zba is not set
# CONFIG_Zbb is not set
# CONFIG_Zbc is not set
# CONFIG_Zbs is not set
# CONFIG_SDL is not set
# CONFIG_SDL_MIXER is not set
CONFIG_OPTIMIZE_SIZE=y
```
